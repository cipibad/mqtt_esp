## main/Kconfig.projbuild
```kconfig
menu "MQTT SSL CONF"

choice DEVICE_TYPE
	prompt "Device type"
	default DEVICE_TYPE_ESP8266
    help
        This is the root name of the MQTT topic or COAP resource /<device_type>/<client_id>

config DEVICE_TYPE_ESP01
	bool "esp01"
config DEVICE_TYPE_ESP12F
	bool "esp12f"
config DEVICE_TYPE_ESP32
	bool "esp32"
config DEVICE_TYPE_ESP8266
	bool "esp8266"
config DEVICE_TYPE_sonoffb
	bool "sonoffb"
config DEVICE_TYPE_sonoffp
	bool "sonoffp"
endchoice

config DEVICE_TYPE
	string
    default "esp01" if DEVICE_TYPE_ESP01
    default "esp12f" if DEVICE_TYPE_ESP12F
    default "esp32" if DEVICE_TYPE_ESP32
    default "esp8266" if DEVICE_TYPE_ESP8266
    default "sonoffb" if DEVICE_TYPE_sonoffb
    default "sonoffp" if DEVICE_TYPE_sonoffp

config TARGET_DEVICE_ESP32
    bool
    default y if DEVICE_TYPE_ESP32

config TARGET_DEVICE_ESP8266
    bool
    default y if DEVICE_TYPE_ESP01
    default y if DEVICE_TYPE_ESP12F
    default y if DEVICE_TYPE_ESP8266
    default y if DEVICE_TYPE_sonoffb
    default y if DEVICE_TYPE_sonoffp

config CLIENT_ID
    string "Client id"
    default "client_id"
    help
        This is the device id of the MQTT topic or COAP resource /<device_type>/<client_id>

menu "WiFi Config"
    choice WIFI_MODE
    bool "Wifi mode"
    default WIFI_MODE_STATION
    help
        Wifi mode, can be station on mixed
    config WIFI_MODE_STATION
    bool "Wifi station only mode"
    config WIFI_MODE_ACCESS_POINT
    bool "Wifi access point only mode"
    config WIFI_MODE_MIXED
    bool "Wifi mixed mode: station and AP(esp8266 only)"
    endchoice

    config WIFI_SSID
        depends on WIFI_MODE_STATION || WIFI_MODE_MIXED
        string "WiFi SSID"
        default "myssid"
        help
            SSID (network name) to connect to

    config WIFI_PASSWORD
        depends on WIFI_MODE_STATION || WIFI_MODE_MIXED
        string "WiFi Password"
        default "mypassword"
        help
            WiFi password (WPA or WPA2) to use

    menu "Wifi AP Config"
        depends on WIFI_MODE_MIXED || WIFI_MODE_ACCESS_POINT

        config WIFI_AP_SSID
            string "WiFi AP SSID"
            default "myapssid"
            depends on WIFI_MODE_MIXED || WIFI_MODE_ACCESS_POINT
            help
                SSID (network name) for Acces Point mode.

        config WIFI_AP_PASSWORD
            string "WiFi AP Password"
            default "myappassword"
            depends on WIFI_MODE_MIXED || WIFI_MODE_ACCESS_POINT
            help
                WiFi password for Acces Point mode.
    endmenu # "Wifi AP Config"
endmenu # "WiFi Config"


choice NORTH_INTERFACE
   bool "Interface to the mng system"
   default NORTH_INTERFACE_MQTT
   help
       Interface to the mng system

config NORTH_INTERFACE_MQTT
   bool "MQTT"
config NORTH_INTERFACE_COAP
   bool "COAP"
config NORTH_INTERFACE_HTTP
   bool "HTTP"
endchoice

menu "MQTT Config"
    depends on NORTH_INTERFACE_MQTT

    config MQTT_USERNAME
        depends on NORTH_INTERFACE_MQTT
        string "Mqtt Username"
        default "myusername"
        help
            Mqtt Username used to connect with

    config MQTT_PASSWORD
        depends on NORTH_INTERFACE_MQTT
        string "Mqtt Password"
        default "mypassword"
        help
            Mqtt password or tocked used to connect

    config MQTT_SERVER
        depends on NORTH_INTERFACE_MQTT
        string "Mqtt server"
        default "mqttserver"
        help
            Mqtt server

    config MQTT_PORT
        depends on NORTH_INTERFACE_MQTT
        string "Mqtt port"
        default "8883"
        help
            Mqtt port
endmenu # "MQTT CONFIG"

menu "COAP Config"
    depends on NORTH_INTERFACE_COAP

    config COAP_SERVER
        string "Coap server"
        default "192.168.4.1"
        help
            Coap server

    config COAP_PORT
        string "Coap port"
        default "5684"
        help
            Coap port
endmenu # "Coap CONFIG"

menu "HTTP Config"
    depends on NORTH_INTERFACE_HTTP

    config HTTP_BASE_URL
        string "HTTP base url"
        default "/018e8a95-9224-77de-82a5-adaa05c9fed1"
        help
            HTTP base url
endmenu # "HTTP CONFIG"

config SENSOR_SUPPORT
    boolean "enable sensor support"
    default n
    help
        Enable sensor support

menu "Sensors configuration"
    depends on SENSOR_SUPPORT

    config SENSOR_READING_INTERVAL
        int "Sensor reading period"
        default 60
        depends on SENSOR_SUPPORT
        help
            Sensor reading period(in seconds)

    config DHT22_SENSOR_SUPPORT
        boolean "enable DHT22 sensor"
        default n
        depends on SENSOR_SUPPORT
        help
            Enable temperature/humidity MQTT sensor readings

    menu "DHT22 Sensor"
        depends on DHT22_SENSOR_SUPPORT
        config DHT22_SENSOR_GPIO
            int "DHT22 sensor gpio"
            default 5
            depends on DHT22_SENSOR_SUPPORT
            help
                Gpio port of dht22 sensor

        choice DHT22_SENSOR_TYPE
            bool "Variant of dht sensor"
            depends on DHT22_SENSOR_SUPPORT
            help
                Variant of dht sensor
            config DHT22_SENSOR_TYPE_AM2301
            bool "AM2301"
            config DHT22_SENSOR_TYPE_SI7021
            bool "SI7021"
        endchoice

        config DHT22_SENSOR_SMA_FACTOR
            int "Simple moving average factor"
            default 1
            depends on DHT22_SENSOR_SUPPORT
            help
                Will provide temperature and humidity as simple moving average of
                so many measures, default 1 means no average, have to be greater
                than 1
    endmenu # "DHT22 Sensor"

    config DS18X20_SENSOR
        boolean "enable DS18X20 sensor"
        default n
        depends on SENSOR_SUPPORT
        help
            Enable temperature DS18X20 sensor readings, multiple
            sensors can use the same bus

    menu "DS18x20 sensors"
        depends on DS18X20_SENSOR

        config DS18X20_SENSOR_GPIO
            int "DS18X20 sensor gpio"
            default 5
            depends on DS18X20_SENSOR
            help
                Gpio port of DS18X20 sensor
    endmenu # "DS18x20 sensors"

    config I2C_SENSOR_SUPPORT
    boolean "enable I2C sensors"
    default n
    depends on SENSOR_SUPPORT
    help
        Enable I2C sensors

    menu "I2C sensor"
        depends on I2C_SENSOR_SUPPORT

        config I2C_SENSOR_SDA_GPIO
            int "I2C sensor SDA GPIO"
            default 14
            help
                SDA Gpio port of I2C sensor

        config I2C_SENSOR_SCL_GPIO
            int "I2C sensor SCL GPIO"
            default 2
            help
                SCL Gpio port of BH1750_SENSOR sensor

        config I2C_SENSOR_CLK_STRETCH_TICK
            int "I2C clock stretch tick"
            default 300
            help
                I2C sensor clock stretch tick

        config BME280_SENSOR
            boolean "enable BME280 sensor"
            default n
            depends on SENSOR_SUPPORT
            help
                Enable temperature/humidity/pressure MQTT sensor readings

        config BH1750_SENSOR
            boolean "enable BH1750 light intensity sensor"
            default n
            depends on SENSOR_SUPPORT
            help
                Enable BH1750 light intensity sensor readings

    endmenu # "I2C sensor"

    config SOIL_MOISTURE_SENSOR
        boolean "enable soil moisture sensor"
        default n
        depends on SENSOR_SUPPORT
        help
            Enable soil moisture MQTT sensor
    menu "Soil moisture sensor"
        depends on SOIL_MOISTURE_SENSOR
        config SOIL_MOISTURE_SENSOR_ADC
            boolean "Soil moisture sensor reading using adc"
            default n
            help
                Soil moisture sensor reading using adc
        config SOIL_MOISTURE_SENSOR_DIGITAL
            boolean "Soil moisture sensor reading using digital pin"
            default n
            help
                Soil moisture sensor reading using digital pin
        config SOIL_MOISTURE_SENSOR_GPIO
            int "Soil moisture sensor GPIO"
            default 3
            depends on SOIL_MOISTURE_SENSOR_DIGITAL
            help
                Soil moisture sensor GPIO
        config SOIL_MOISTURE_SENSOR_SWITCH
            boolean "enable soil moisture sensor switch"
            default n
            depends on SENSOR_SUPPORT
            help
                Enable soil moisture MQTT switch control to reduce current usage(eg. when running on battery)
        config SOIL_MOISTURE_SENSOR_SWITCH_GPIO
            int "Soil moisture sensor switch GPIO"
            default 5
            depends on SOIL_MOISTURE_SENSOR_SWITCH
            help
                Soil moisture sensor switch GPIO
    endmenu # "Soil moisture sensor"
endmenu # "Sensors configuration"


config DEEP_SLEEP_MODE
    boolean "enable deep sleep mode"
    default n
    help
        Enable deep sleep mode
menu "Deep sleep config"
    depends on DEEP_SLEEP_MODE
    config DEEP_SLEEP_MODE_PERIOD
        int "number of seconds to sleep"
        default 60
        help
            number of seconds to sleep
endmenu # "Deep sleep config"


config COAP_SERVER_SUPPORT
    depends on !DEEP_SLEEP_MODE
    boolean "enable COAP server"
    default n
    help
        Enable COAP server. Needed for COAP proxy or COAP thermostat sensor
menu "COAP server config"
    depends on COAP_SERVER_SUPPORT

    config COAP_PROXY_SUPPORT
        boolean "enable COAP proxy"
        default n
        help
            Enable COAP proxy
    menu "COAP proxy paths"
        depends on COAP_PROXY_SUPPORT
        config COAP_PROXY_PATHS_NB
            int "number of COAP paths to proxy"
            default 0
            range 0 2
            help
                number of COAP paths to proxy
        config COAP_PROXY_PATH_NB0
            string "COAP path 0 to proxy"
            depends on COAP_PROXY_PATHS_NB > 0
            default ""
            help
                COAP path 0 to proxy
        config COAP_PROXY_PATH_NB1
            string "COAP path 1 to proxy"
            depends on COAP_PROXY_PATHS_NB > 1
            default ""
            help
                COAP path 1 to proxy
    endmenu # "COAP proxy paths"
endmenu # "COAP server config"

config MQTT_RELAYS_NB
    int "number of relays to control"
    depends on !DEEP_SLEEP_MODE
    default 0
    range 0 4
    help
        number of relays to control

menu "Relay Config"
    depends on MQTT_RELAYS_NB > 0

    menu "Relay 0 Config"
        depends on MQTT_RELAYS_NB > 0

        choice MQTT_RELAY_0_TYPE
           bool "Relay 0 type"
           default MQTT_RELAY_0_TYPE_GPIO
           help
               Relay 0 type
        config MQTT_RELAY_0_TYPE_GPIO
           bool "Relay is controlled using GPIO"
        config MQTT_RELAY_0_TYPE_SERIAL
           bool "Relay is controlled using serial command"
        endchoice

        config MQTT_RELAY_0_GPIO
            int "relay 0 gpio port"
            depends on MQTT_RELAY_0_TYPE_GPIO
            default 4
            help
                relay 0 gpio port

        config MQTT_RELAY_0_SERIAL_ON
           hex "relay 0 enable serial command"
           depends on MQTT_RELAY_0_TYPE_SERIAL
           default ""
           help
               relay 0 enable serial command

        config MQTT_RELAY_0_SERIAL_OFF
           hex "relay 0 disable serial command"
           depends on MQTT_RELAY_0_TYPE_SERIAL
           default ""
           help
               relay 0 disable serial command

    endmenu # "Relay 0 Config"

    menu "Relay 1 Config"
        depends on MQTT_RELAYS_NB > 1

        choice MQTT_RELAY_1_TYPE
           bool "Relay 1 type"
           default MQTT_RELAY_1_TYPE_GPIO
           help
               Relay 1 type
        config MQTT_RELAY_1_TYPE_GPIO
           bool "Relay is controlled using GPIO"
        config MQTT_RELAY_1_TYPE_SERIAL
           bool "Relay is controlled using serial command"
        endchoice

        config MQTT_RELAY_1_GPIO
            int "relay 1 gpio port"
            depends on MQTT_RELAY_1_TYPE_GPIO
            default 4
            help
                relay 1 gpio port

        config MQTT_RELAY_1_SERIAL_ON
           hex "relay 1 enable serial command"
           depends on MQTT_RELAY_1_TYPE_SERIAL
           default ""
           help
               relay 1 enable serial command

        config MQTT_RELAY_1_SERIAL_OFF
           hex "relay 1 disable serial command"
           depends on MQTT_RELAY_1_TYPE_SERIAL
           default ""
           help
               relay 1 disable serial command

    endmenu # "Relay 1 Config"

    menu "Relay 2 Config"
        depends on MQTT_RELAYS_NB > 2

        choice MQTT_RELAY_2_TYPE
           bool "Relay 2 type"
           default MQTT_RELAY_2_TYPE_GPIO
           help
               Relay 2 type
        config MQTT_RELAY_2_TYPE_GPIO
           bool "Relay is controlled using GPIO"
        config MQTT_RELAY_2_TYPE_SERIAL
           bool "Relay is controlled using serial command"
        endchoice

        config MQTT_RELAY_2_GPIO
            int "relay 2 gpio port"
            depends on MQTT_RELAY_2_TYPE_GPIO
            default 4
            help
                relay 2 gpio port

        config MQTT_RELAY_2_SERIAL_ON
           hex "relay 2 enable serial command"
           depends on MQTT_RELAY_2_TYPE_SERIAL
           default ""
           help
               relay 2 enable serial command

        config MQTT_RELAY_2_SERIAL_OFF
           hex "relay 2 disable serial command"
           depends on MQTT_RELAY_2_TYPE_SERIAL
           default ""
           help
               relay 2 disable serial command

    endmenu # "Relay 2 Config"

    menu "Relay 3 Config"
        depends on MQTT_RELAYS_NB > 3

        choice MQTT_RELAY_3_TYPE
           bool "Relay 3 type"
           default MQTT_RELAY_3_TYPE_GPIO
           help
               Relay 3 type
        config MQTT_RELAY_3_TYPE_GPIO
           bool "Relay is controlled using GPIO"
        config MQTT_RELAY_3_TYPE_SERIAL
           bool "Relay is controlled using serial command"
        endchoice

        config MQTT_RELAY_3_GPIO
            int "relay 3 gpio port"
            depends on MQTT_RELAY_3_TYPE_GPIO
            default 4
            help
                relay 3 gpio port

        config MQTT_RELAY_3_SERIAL_ON
           hex "relay 3 enable serial command"
           depends on MQTT_RELAY_3_TYPE_SERIAL
           default ""
           help
               relay 3 enable serial command

        config MQTT_RELAY_3_SERIAL_OFF
           hex "relay 3 disable serial command"
           depends on MQTT_RELAY_3_TYPE_SERIAL
           default ""
           help
               relay 3 disable serial command

    endmenu # "Relay 3 Config"

endmenu # "Relay Config"

config STATUS_LED
    boolean "enable status LED"
    default n
    help
        Enable status LED
menu "Status LED config"
    depends on STATUS_LED
    config STATUS_LED_GPIO
        int "status LED GPIO"
        default 2
        help
            status LED GPIO
endmenu # "Status LED config"

config MQTT_SWITCHES_NB
    int "number of switches to control"
    default 0
    range 0 4
    help
        number of relays to control

config MQTT_SWITCHES_NB0_GPIO
    int "switch 0 gpio port"
    depends on MQTT_SWITCHES_NB > 0
    default 0
    help
        switch 0 gpio port

config MQTT_SWITCHES_NB1_GPIO
    int "switch 1 gpio port"
    depends on MQTT_SWITCHES_NB > 1
    default 9
    help
        switch 1 gpio port

config MQTT_SWITCHES_NB2_GPIO
    int "switch 2 gpio port"
    depends on MQTT_SWITCHES_NB > 2
    default 10
    help
        switch 2 gpio port

config MQTT_SWITCHES_NB3_GPIO
    int "switch 3 gpio port"
    depends on MQTT_SWITCHES_NB > 3
    default 14
    help
        switch 1 gpio port


config MQTT_OTA
    boolean "enable OTA support"
    depends on !DEEP_SLEEP_MODE
    default y
    help
        Enable OTA support

config MQTT_OPS
    boolean "enable OPS support"
    depends on !DEEP_SLEEP_MODE

    default n
    help
        Enable OPS support

config MQTT_OPS_HEAP
    boolean "enable OPS heap"
    default n
    depends on MQTT_OPS
    help
        Enable OPS heap support

config MQTT_OPS_STACK
    boolean "enable OPS stack"
    default n
    depends on MQTT_OPS
    help
        Enable OPS stack support

config MQTT_THERMOSTATS_NB
    int "number of virtual thermostats"
    depends on !DEEP_SLEEP_MODE

    default 0
    range 0 6
    help
        Number of virtual thermostats

config MQTT_THERMOSTAT_RELAY_ID
   int "Thermostat Relay Id"
   default 0
   depends on MQTT_THERMOSTATS_NB > 0
   help
       Thermostat relay id

config MQTT_THERMOSTATS_TICK_PERIOD
   int "Interval on which the thermostat action happens"
   default 60
   depends on MQTT_THERMOSTATS_NB > 0
   help
       Interval on which the thermostat action happens(in seconds)

config MQTT_THERMOSTAT_ENABLE_NOTIFICATIONS
   bool "Enable thermostat notifications"
   default n
   depends on MQTT_THERMOSTATS_NB > 0
   help
        There is partial implementation for user friendly notifications message
        to be send when thermostat is toggled on/off. Still, it seems the message
        size if to big for mqtt esp8266 stack, use this option to enable and fix it
        if needed

choice MQTT_THERMOSTAT_ID_CIRCUIT_OPTIMIZER
   bool "Id of thermostat handling circuit optimisation"
   depends on MQTT_THERMOSTATS_NB > 0
   help
       Id of thermostat handling circuit optimisation
config MQTT_NO_THERMOSTATS_TYPE_CIRCUIT
   bool "No thermostat of type water circuit"
config MQTT_THERMOSTATS_NB0_TYPE_CIRCUIT
   bool "Thermostat id 0"
config MQTT_THERMOSTATS_NB1_TYPE_CIRCUIT
   bool "Thermostat id 1"
   depends on MQTT_THERMOSTATS_NB > 1
config MQTT_THERMOSTATS_NB2_TYPE_CIRCUIT
   bool "Thermostat id 2"
   depends on MQTT_THERMOSTATS_NB > 2
config MQTT_THERMOSTATS_NB3_TYPE_CIRCUIT
   bool "Thermostat id 3"
   depends on MQTT_THERMOSTATS_NB > 3
config MQTT_THERMOSTATS_NB4_TYPE_CIRCUIT
   bool "Thermostat id 4"
   depends on MQTT_THERMOSTATS_NB > 4
config MQTT_THERMOSTATS_NB5_TYPE_CIRCUIT
   bool "Thermostat id 5"
   depends on MQTT_THERMOSTATS_NB > 5
endchoice

config MQTT_THERMOSTATS_NB0_FRIENDLY_NAME
   string "Thermostat 0 friendly name"
   depends on MQTT_THERMOSTATS_NB > 0
   default "t0"
   help
       Thermostat 0 friendly name

choice MQTT_THERMOSTATS_NB0_WATERPUMP
   bool "Thermostat 0 water pump"
   depends on MQTT_THERMOSTATS_NB > 0 && WATERPUMP_SUPPORT
   default MQTT_THERMOSTATS_NB0_WATERPUMP_OFF
   help
       Thermostat water pump
config MQTT_THERMOSTATS_NB0_WATERPUMP_OFF
   bool "Water pump off"
config MQTT_THERMOSTATS_NB0_WATERPUMP_ON
   bool "Water pump on"
endchoice

choice MQTT_THERMOSTATS_NB0_SENSOR_TYPE
   bool "Thermostat 0 sensor type"
   depends on MQTT_THERMOSTATS_NB > 0
   default MQTT_THERMOSTATS_NB0_SENSOR_TYPE_LOCAL
   help
       Thermostat sensor type
config MQTT_THERMOSTATS_NB0_SENSOR_TYPE_MQTT
   bool "Mqtt sensor"
   depends on NORTH_INTERFACE_MQTT
config MQTT_THERMOSTATS_NB0_SENSOR_TYPE_LOCAL
   bool "Local sensor"
config MQTT_THERMOSTATS_NB0_SENSOR_TYPE_COAP
   bool "Coap sensor"
   depends on COAP_SERVER_SUPPORT
endchoice

config MQTT_THERMOSTATS_NB0_MQTT_SENSOR_TOPIC
   string "Thermostat 0 mqtt sensor topic"
   depends on MQTT_THERMOSTATS_NB0_SENSOR_TYPE_MQTT
   default ""
   help
       Sensor topic

config MQTT_THERMOSTATS_NB0_LOCAL_SENSOR_TOPIC
   string "Thermostat 0 local sensor topic"
   depends on MQTT_THERMOSTATS_NB0_SENSOR_TYPE_LOCAL
   default ""
   help
       Sensor topic

config MQTT_THERMOSTATS_NB0_COAP_SENSOR_RESOURCE
   string "Thermostat 0 coap sensor resource"
   depends on MQTT_THERMOSTATS_NB0_SENSOR_TYPE_COAP
   default ""
   help
       Sensor coap resource

config MQTT_THERMOSTATS_NB1_FRIENDLY_NAME
   string "Thermostat 1 friendly name"
   depends on MQTT_THERMOSTATS_NB > 1
   default "t1"
   help
       Thermostat 1 friendly name

choice MQTT_THERMOSTATS_NB1_WATERPUMP
   bool "Thermostat 1 water pump"
   depends on MQTT_THERMOSTATS_NB > 1 && WATERPUMP_SUPPORT
   default MQTT_THERMOSTATS_NB1_WATERPUMP_OFF
   help
       Thermostat water pump
config MQTT_THERMOSTATS_NB1_WATERPUMP_OFF
   bool "Water pump off"
config MQTT_THERMOSTATS_NB1_WATERPUMP_ON
   bool "Water pump on"
endchoice

choice MQTT_THERMOSTATS_NB1_SENSOR_TYPE
   bool "Thermostat 1 sensor type"
   depends on MQTT_THERMOSTATS_NB > 1
   default MQTT_THERMOSTATS_NB1_SENSOR_TYPE_LOCAL
   help
       Thermostat sensor type
config MQTT_THERMOSTATS_NB1_SENSOR_TYPE_MQTT
   bool "Mqtt sensor"
   depends on NORTH_INTERFACE_MQTT
config MQTT_THERMOSTATS_NB1_SENSOR_TYPE_LOCAL
   bool "Local sensor"
config MQTT_THERMOSTATS_NB1_SENSOR_TYPE_COAP
   depends on COAP_SERVER_SUPPORT
   bool "Coap sensor"

endchoice

config MQTT_THERMOSTATS_NB1_MQTT_SENSOR_TOPIC
   string "Thermostat 1 mqtt sensor topic"
   depends on MQTT_THERMOSTATS_NB1_SENSOR_TYPE_MQTT
   default ""
   help
       Sensor topic

config MQTT_THERMOSTATS_NB1_LOCAL_SENSOR_TOPIC
   string "Thermostat 1 local sensor topic"
   depends on MQTT_THERMOSTATS_NB1_SENSOR_TYPE_LOCAL
   default ""
   help
       Sensor topic

config MQTT_THERMOSTATS_NB1_COAP_SENSOR_RESOURCE
   string "Thermostat 1 coap sensor resource"
   depends on MQTT_THERMOSTATS_NB1_SENSOR_TYPE_COAP
   default ""
   help
       Sensor coap resource

config MQTT_THERMOSTATS_NB2_FRIENDLY_NAME
   string "Thermostat 2 friendly name"
   depends on MQTT_THERMOSTATS_NB > 2
   default "t2"
   help
       Thermostat 2 friendly name

choice MQTT_THERMOSTATS_NB2_WATERPUMP
   bool "Thermostat 2 water pump"
   depends on MQTT_THERMOSTATS_NB > 2 && WATERPUMP_SUPPORT
   default MQTT_THERMOSTATS_NB2_WATERPUMP_OFF
   help
       Thermostat water pump
config MQTT_THERMOSTATS_NB2_WATERPUMP_OFF
   bool "Water pump off"
config MQTT_THERMOSTATS_NB2_WATERPUMP_ON
   bool "Water pump on"
endchoice

choice MQTT_THERMOSTATS_NB2_SENSOR_TYPE
   bool "Thermostat 2 sensor type"
   depends on MQTT_THERMOSTATS_NB > 2
   default MQTT_THERMOSTATS_NB2_SENSOR_TYPE_LOCAL
   help
       Thermostat sensor type
config MQTT_THERMOSTATS_NB2_SENSOR_TYPE_MQTT
   bool "Mqtt sensor"
   depends on NORTH_INTERFACE_MQTT
config MQTT_THERMOSTATS_NB2_SENSOR_TYPE_LOCAL
   bool "Local sensor"
config MQTT_THERMOSTATS_NB2_SENSOR_TYPE_COAP
   bool "Coap sensor"
   depends on COAP_SERVER_SUPPORT
endchoice

config MQTT_THERMOSTATS_NB2_MQTT_SENSOR_TOPIC
   string "Thermostat 2 mqtt sensor topic"
   depends on MQTT_THERMOSTATS_NB2_SENSOR_TYPE_MQTT
   default ""
   help
       Sensor topic

config MQTT_THERMOSTATS_NB2_LOCAL_SENSOR_TOPIC
   string "Thermostat 2 local sensor topic"
   depends on MQTT_THERMOSTATS_NB2_SENSOR_TYPE_LOCAL
   default ""
   help
       Sensor topic

config MQTT_THERMOSTATS_NB2_COAP_SENSOR_RESOURCE
   string "Thermostat 2 coap sensor resource"
   depends on MQTT_THERMOSTATS_NB2_SENSOR_TYPE_COAP
   default ""
   help
       Sensor coap resource

config MQTT_THERMOSTATS_NB3_FRIENDLY_NAME
   string "Thermostat 3 friendly name"
   depends on MQTT_THERMOSTATS_NB > 3
   default "t3"
   help
       Thermostat 3 friendly name

choice MQTT_THERMOSTATS_NB3_WATERPUMP
   bool "Thermostat 3 water pump"
   depends on MQTT_THERMOSTATS_NB > 3 && WATERPUMP_SUPPORT
   default MQTT_THERMOSTATS_NB3_WATERPUMP_OFF
   help
       Thermostat water pump
config MQTT_THERMOSTATS_NB3_WATERPUMP_OFF
   bool "Water pump off"
config MQTT_THERMOSTATS_NB3_WATERPUMP_ON
   bool "Water pump on"
endchoice

choice MQTT_THERMOSTATS_NB3_SENSOR_TYPE
   bool "Thermostat 3 sensor type"
   depends on MQTT_THERMOSTATS_NB > 3
   default MQTT_THERMOSTATS_NB3_SENSOR_TYPE_LOCAL
   help
       Thermostat sensor type
config MQTT_THERMOSTATS_NB3_SENSOR_TYPE_MQTT
   bool "Mqtt sensor"
   depends on NORTH_INTERFACE_MQTT
config MQTT_THERMOSTATS_NB3_SENSOR_TYPE_LOCAL
   bool "Local sensor"
config MQTT_THERMOSTATS_NB3_SENSOR_TYPE_COAP
   bool "Coap sensor"
   depends on COAP_SERVER_SUPPORT
endchoice

config MQTT_THERMOSTATS_NB3_MQTT_SENSOR_TOPIC
   string "Thermostat 3 mqtt sensor topic"
   depends on MQTT_THERMOSTATS_NB3_SENSOR_TYPE_MQTT
   default ""
   help
       Sensor topic

config MQTT_THERMOSTATS_NB3_LOCAL_SENSOR_TOPIC
   string "Thermostat 3 local sensor topic"
   depends on MQTT_THERMOSTATS_NB3_SENSOR_TYPE_LOCAL
   default ""
   help
       Sensor topic

config MQTT_THERMOSTATS_NB3_COAP_SENSOR_RESOURCE
   string "Thermostat 3 coap sensor resource"
   depends on MQTT_THERMOSTATS_NB3_SENSOR_TYPE_COAP
   default ""
   help
       Sensor coap resource

###
config MQTT_THERMOSTATS_NB4_FRIENDLY_NAME
   string "Thermostat 4 friendly name"
   depends on MQTT_THERMOSTATS_NB > 4
   default "t4"
   help
       Thermostat 4 friendly name

choice MQTT_THERMOSTATS_NB4_WATERPUMP
   bool "Thermostat 4 water pump"
   depends on MQTT_THERMOSTATS_NB > 4 && WATERPUMP_SUPPORT
   default MQTT_THERMOSTATS_NB4_WATERPUMP_OFF
   help
       Thermostat water pump
config MQTT_THERMOSTATS_NB4_WATERPUMP_OFF
   bool "Water pump off"
config MQTT_THERMOSTATS_NB4_WATERPUMP_ON
   bool "Water pump on"
endchoice

choice MQTT_THERMOSTATS_NB4_SENSOR_TYPE
   bool "Thermostat 4 sensor type"
   depends on MQTT_THERMOSTATS_NB > 4
   default MQTT_THERMOSTATS_NB4_SENSOR_TYPE_LOCAL
   help
       Thermostat sensor type
config MQTT_THERMOSTATS_NB4_SENSOR_TYPE_MQTT
   bool "Mqtt sensor"
   depends on NORTH_INTERFACE_MQTT
config MQTT_THERMOSTATS_NB4_SENSOR_TYPE_LOCAL
   bool "Local sensor"
config MQTT_THERMOSTATS_NB4_SENSOR_TYPE_COAP
   bool "Coap sensor"
   depends on COAP_SERVER_SUPPORT
endchoice

config MQTT_THERMOSTATS_NB4_MQTT_SENSOR_TOPIC
   string "Thermostat 4 mqtt sensor topic"
   depends on MQTT_THERMOSTATS_NB4_SENSOR_TYPE_MQTT
   default ""
   help
       Sensor topic

config MQTT_THERMOSTATS_NB4_LOCAL_SENSOR_TOPIC
   string "Thermostat 4 local sensor topic"
   depends on MQTT_THERMOSTATS_NB4_SENSOR_TYPE_LOCAL
   default ""
   help
       Sensor topic

config MQTT_THERMOSTATS_NB4_COAP_SENSOR_RESOURCE
   string "Thermostat 4 coap sensor resource"
   depends on MQTT_THERMOSTATS_NB4_SENSOR_TYPE_COAP
   default ""
   help
       Sensor coap resource

####
config MQTT_THERMOSTATS_NB5_FRIENDLY_NAME
   string "Thermostat 5 friendly name"
   depends on MQTT_THERMOSTATS_NB > 5
   default "t5"
   help
       Thermostat 5 friendly name

choice MQTT_THERMOSTATS_NB5_WATERPUMP
   bool "Thermostat 5 water pump"
   depends on MQTT_THERMOSTATS_NB > 5 && WATERPUMP_SUPPORT
   default MQTT_THERMOSTATS_NB5_WATERPUMP_OFF
   help
       Thermostat water pump
config MQTT_THERMOSTATS_NB5_WATERPUMP_OFF
   bool "Water pump off"
config MQTT_THERMOSTATS_NB5_WATERPUMP_ON
   bool "Water pump on"
endchoice

choice MQTT_THERMOSTATS_NB5_SENSOR_TYPE
   bool "Thermostat 5 sensor type"
   depends on MQTT_THERMOSTATS_NB > 5
   default MQTT_THERMOSTATS_NB5_SENSOR_TYPE_LOCAL
   help
       Thermostat sensor type
config MQTT_THERMOSTATS_NB5_SENSOR_TYPE_MQTT
   bool "Mqtt sensor"
   depends on NORTH_INTERFACE_MQTT
config MQTT_THERMOSTATS_NB5_SENSOR_TYPE_LOCAL
   bool "Local sensor"
config MQTT_THERMOSTATS_NB5_SENSOR_TYPE_COAP
   bool "Coap sensor"
   depends on COAP_SERVER_SUPPORT
endchoice

config MQTT_THERMOSTATS_NB5_MQTT_SENSOR_TOPIC
   string "Thermostat 5 mqtt sensor topic"
   depends on MQTT_THERMOSTATS_NB5_SENSOR_TYPE_MQTT
   default ""
   help
       Sensor topic

config MQTT_THERMOSTATS_NB5_LOCAL_SENSOR_TOPIC
   string "Thermostat 5 local sensor topic"
   depends on MQTT_THERMOSTATS_NB5_SENSOR_TYPE_LOCAL
   default ""
   help
       Sensor topic

config MQTT_THERMOSTATS_NB5_COAP_SENSOR_RESOURCE
   string "Thermostat 5 coap sensor resource"
   depends on MQTT_THERMOSTATS_NB5_SENSOR_TYPE_COAP
   default ""
   help
       Sensor coap resource

#######################
config WATERPUMP_SUPPORT
    boolean "enable external waterpump support"
    depends on !DEEP_SLEEP_MODE
    default n
    help
        Enable external waterpump support

menu "Waterpump configuration"
    depends on WATERPUMP_SUPPORT

    config WATERPUMP_VALVE_OPEN_GPIO
        int "GPIO to open the valve"
        default 25
        help
            GPIO to open the valve

    config WATERPUMP_VALVE_CLOSE_GPIO
        int "GPIO to close the valve"
        default 26
        help
            GPIO to close the valve

    config WATERPUMP_RELAY_ID
        int "relay id to start/stop the water pump"
        default 1
        help
            GPIO to start/stop the water pump

    config WATERPUMP_ENABLE_NOTIFICATIONS
        bool "Enable waterpump notifications"
        default n
        help
            There is partial implementation for user friendly notifications
endmenu # "Waterpump"

#######################
config ACTUATOR_SUPPORT
    boolean "enable external actuator support"
    depends on !DEEP_SLEEP_MODE
    default n
    help
        Enable external actuator support

menu "Actuator configuration"
    depends on ACTUATOR_SUPPORT

    config ACTUATOR_MASTER_POSITIVE_GPIO
        int "GPIO to control positive master relay"
        default 12
        help
            GPIO to control positive master relay, see schematics

    config ACTUATOR_MASTER_NEGATIVE_GPIO
        int "GPIO to control negative master relay"
        default 13
        help
            GPIO to control negative master relay, see schematics

    config ACTUATOR_OPEN_GPIO
        int "GPIO to control actuator open relay"
        default 14
        help
            GPIO to control actuator open relay, see schematics

    config ACTUATOR_CLOSE_GPIO
        int "GPIO to control actuator close relay"
        default 16
        help
            GPIO to control actuator close relay, see schematics

endmenu # "Actuator configuration"

#######################

config MQTT_SCHEDULERS
    boolean "enable schedulers support"
    depends on !DEEP_SLEEP_MODE
    default n
    help
        Enable schedulers support

config MOTION_SENSOR_SUPPORT
    boolean "enable motion sensor support"
    default n
    help
        Enable motion sensor support

menu "Motion sensor configuration"
    depends on MOTION_SENSOR_SUPPORT

    config MOTION_SENSOR_GPIO
        int "GPIO to motion sensor"
        default 4
        help
            GPIO to motion sensor

    config MOTION_SENSOR_DISABLE_TIMER
        int "number of seconds to wait before disabling sensor"
        default 5
        help
            After we receive low on GPIO we wait MOTION_SENSOR_DISABLE_TIMER seconds
            before also disabling sensor status

endmenu # "Motion sensor configuration"

config PRESENCE_AUTOMATION_SUPPORT
    depends on MOTION_SENSOR_SUPPORT
    boolean "enable presence automation support"
    default n
    help
        Enable presence automation support

menu "Presence automation configuration"
    depends on PRESENCE_AUTOMATION_SUPPORT

    config PRESENCE_AUTOMATION_DISABLE_TIMER
        int "number of seconds to wait before disabling light"
        default 15
        help
            After motion disabled we wait PRESENCE_AUTOMATION_DISABLE_TIMER seconds
            before also disabling the light

    config PRESENCE_AUTOMATION_ILLUMINANCE_THRESHOLD
        depends on BH1750_SENSOR
        int "Illuminance threshold to enable presence automation"
        default 100
        help
            Illuminance threshold to enable presence automation

endmenu # "Presence automation configuration"

endmenu
```
